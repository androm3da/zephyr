## arch/hexagon/core/Kconfig
```kconfig
# SPDX-License-Identifier: Apache-2.0
# Copyright (c) Qualcomm Technologies, Inc. and/or its subsidiaries.

config CPU_HAS_TLS
	bool
	help
	  This option is enabled when the CPU has hardware thread local storage.

if MMU
config MMU_PAGE_SIZE
	hex "MMU page size"
	default 0x10000
	help
	  Hexagon VM supports multiple page sizes: 4KB (0x1000), 16KB (0x4000),
	  64KB (0x10000), 256KB (0x40000), 1MB (0x100000), 4MB (0x400000), 16MB (0x1000000).

	  Larger page sizes reduce the number of TLB entries needed, which can help
	  avoid "TLB index beyond limit" errors from the loadlinux bootloader.

	  Default is 64KB (0x10000).  Larger pages cause excessive binary bloat
	  due to alignment padding (e.g., 4MB pages create 13MB binaries).
endif

config MAIN_STACK_SIZE
	default 2048

config IDLE_STACK_SIZE
	default 1024

config ISR_STACK_SIZE
	default 4096

config ARCH_HAS_STACKWALK
	bool
	default y
	imply THREAD_STACK_INFO

config HEXAGON_EXCEPTION_DEBUG
	bool "Hexagon exception debugging"
	help
	  Enable debugging of Hexagon exceptions and events

config TEST_EXTRA_STACK_SIZE
	default 2048
```

## samples/hello_world/boards/qemu_hexagon_qemu_hexagon_virt.conf
```kconfig
# Hexagon-specific configuration for hello_world sample with picolibc

# Use picolibc instead of minimal libc
CONFIG_MINIMAL_LIBC=n
CONFIG_PICOLIBC=y

# Console via PL011 UART
CONFIG_SERIAL=y
CONFIG_UART_CONSOLE=y
CONFIG_CONSOLE=y
CONFIG_PRINTK=y
CONFIG_EARLY_CONSOLE=y

# Build system configuration
CONFIG_LLVM_USE_LLD=y
CONFIG_COMPILER_RT_RTLIB=y

# System configuration
CONFIG_SYS_CLOCK_HW_CYCLES_PER_SEC=1000000
CONFIG_SYS_CLOCK_TICKS_PER_SEC=1000
CONFIG_SRAM_BASE_ADDRESS=0xa0000000

# Memory configuration
CONFIG_MAIN_STACK_SIZE=4096
CONFIG_ISR_STACK_SIZE=4096
CONFIG_HEAP_MEM_POOL_SIZE=16384

# Hexagon-specific features
CONFIG_HEXAGON_TIMER=y

# Debug and development options
CONFIG_EXCEPTION_DEBUG=y

# QEMU-specific configuration
CONFIG_QEMU_ICOUNT_SHIFT=3

# Advanced features
CONFIG_HW_STACK_PROTECTION=y
```

## tests/scripts/gdb/testcase.yaml
```yaml
#
# Copyright (c) Qualcomm Technologies, Inc. and/or its subsidiaries.
#
# SPDX-License-Identifier: Apache-2.0
#

common:
  tags:
    - debug
    - gdb

tests:
  debug.gdb_plugin.rtos_awareness:
    platform_allow:
      - qemu_cortex_m3
    harness: pytest
    harness_config:
      pytest_root:
        - "pytest/test_gdb_plugin.py"
      pytest_args:
        - "--gdb_timeout"
        - "30"
        - "--gdb_script"
        - "test_plugin.gdbinit"
        - "--gdb_target_remote"
        - "tcp::1236"
    extra_configs:
      # Disable Zephyr's gdbstub, use QEMU's native gdbstub
      - CONFIG_GDBSTUB=n
      # Enable thread monitoring for plugin
      - CONFIG_THREAD_MONITOR=y
      - CONFIG_THREAD_NAME=y
      # Halt QEMU at startup and listen for GDB on unique port
      - CONFIG_QEMU_EXTRA_FLAGS="-S -gdb tcp::1236"
      # Clear default QEMU gdb port
      - CONFIG_QEMU_GDBSERVER_LISTEN_DEV=""
```
