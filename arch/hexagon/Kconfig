## arch/hexagon/Kconfig
```kconfig
# SPDX-License-Identifier: Apache-2.0
# Copyright (c) 2025 Qualcomm Innovation Center, Inc. All rights reserved.

config ARCH
	string
	default "hexagon"

config HEXAGON_VM
	bool "Hexagon Virtual Machine support"
	default y
	help
	  Enable Hexagon Virtual Machine support. This provides VM
	  instructions for interrupt control, timer operations, and
	  memory management.

config HEXAGON_HW_THREADS
	bool "Enable hardware thread support"
	default n
	help
	  Enable support for multiple hardware threads using Hexagon VM operations.
	  This allows threads to be assigned to specific virtual processors.

config HEXAGON_HW_THREADS_MAX
	int "Maximum number of hardware threads"
	default 4
	range 1 6
	depends on HEXAGON_HW_THREADS
	help
	  Maximum number of hardware threads supported by the Hexagon core

menu "Hexagon Options"

config HEXAGON_VM_VERSION
	hex "Hexagon VM version"
	default 0x0700
	help
	  Version of Hexagon VM interface to use

config HEXAGON_QEMU_SUPPORT
	bool "Enhanced QEMU support"
	default y if QEMU_TARGET
	help
	  Enable enhanced QEMU support with debugging and networking features.

config HEXAGON_HVX
	bool "Hexagon Vector Extensions (HVX) support"
	default n
	help
	  Enable support for Hexagon Vector Extensions (HVX). HVX provides
	  SIMD vector processing capabilities with 32 vector registers and
	  vector predicate registers. This feature requires hardware support
	  and increases memory usage for thread context storage.

if HEXAGON_HVX

config HEXAGON_HVX_128B
	bool "Use 128-byte HVX vectors"
	default y
	help
	  Use 128-byte HVX vectors instead of 64-byte vectors. This provides
	  more vector processing capability but increases memory usage for
	  context storage. The actual vector size depends on hardware support.

config HEXAGON_HVX_MAX_CONTEXTS
	int "Maximum number of HVX contexts"
	default 4
	range 1 8
	help
	  Maximum number of HVX contexts that can be allocated simultaneously.
	  Set this to correspond with the target capability.


endif # HEXAGON_HVX

endmenu

source "arch/hexagon/core/Kconfig"
```

## boards/hexagon/hexagon_sim/Kconfig.board
```kconfig
# Copyright (c) 2025 Qualcomm Innovation Center, Inc. All rights reserved.
# SPDX-License-Identifier: Apache-2.0

config BOARD_HEXAGON_SIM
	bool "Hexagon Simulator/QEMU"
	select SOC_SERIES_HEXAGON_V66
	select SOC_HEXAGON_V66
```

## boards/hexagon/hexagon_sim/Kconfig.defconfig
```kconfig
# Copyright (c) 2025 Qualcomm Innovation Center, Inc. All rights reserved.
# SPDX-License-Identifier: Apache-2.0

if BOARD_HEXAGON_SIM

config BOARD
	default "hexagon_sim"

config SYS_CLOCK_HW_CYCLES_PER_SEC
	default 500000000

config UART_PL011
	default y if SERIAL

endif # BOARD_HEXAGON_SIM
```

## boards/hexagon/hexagon_sim/hexagon_sim_defconfig
```kconfig
# SOC configuration is handled by HWMv2 automatically
CONFIG_SYS_CLOCK_HW_CYCLES_PER_SEC=500000000

# Disable LVGL for Hexagon architecture (no display support yet)
CONFIG_LVGL=n
CONFIG_MAIN_STACK_SIZE=2048
CONFIG_IDLE_STACK_SIZE=512
CONFIG_ISR_STACK_SIZE=2048
CONFIG_XIP=n
CONFIG_CONSOLE=y
CONFIG_UART_CONSOLE=y
CONFIG_SERIAL=y
CONFIG_UART_PL011=y
```

## boards/hexagon/qemu_hexagon_virt/Kconfig.board
```kconfig
# Copyright (c) 2022 Qualcomm Innovation Center, Inc.
# SPDX-License-Identifier: Apache-2.0

config BOARD_QEMU_HEXAGON_VIRT
	bool "Hexagon Emulation (QEMU)"
	select HEXAGON
	select QEMU_TARGET

# /pkg/qct/software/hexagon/releases/tools/8.4.08/Tools//bin/hexagon-llvm-objcopy: error: too many positional arguments
CONFIG_BUILD_OUTPUT_BIN=n
```

## boards/hexagon/qemu_hexagon_virt/Kconfig.defconfig
```kconfig
# Copyright (c) 2022 Qualcomm Innovation Center, Inc.
# SPDX-License-Identifier: Apache-2.0

config BOARD
        default "qemu_hexagon_virt"


# /pkg/qct/software/hexagon/releases/tools/8.4.08/Tools//bin/hexagon-llvm-objcopy: error: too many positional arguments
CONFIG_BUILD_OUTPUT_BIN=n


config HAVE_CUSTOM_LINKER_SCRIPT
	default y

config CUSTOM_LINKER_SCRIPT
	default "${ZEPHYR_BASE}/boards/hexagon/qemu_hexagon_virt/static-executable.lcs.template"
```

## boards/hexagon/qemu_hexagon_virt/qemu_hexagon_virt_defconfig
```kconfig
# SPDX-License-Identifier: Apache-2.0

CONFIG_MAIN_STACK_SIZE=2048
#CONFIG_BOARD_HEXAGON=y
CONFIG_CONSOLE=y

#CONFIG_GEN_ISR_TABLES=y
#CONFIG_GEN_IRQ_VECTOR_TABLE=y

# FIXME
CONFIG_SOC_SERIES_HEXAGON_VIRT=y
CONFIG_SYS_CLOCK_HW_CYCLES_PER_SEC=500000000
CONFIG_QEMU_ICOUNT_SHIFT=1
CONFIG_BUILD_NO_GAP_FILL=y
CONFIG_COMPILER_OPT="-G0"
```

## boards/qemu/hexagon/Kconfig
```kconfig
# Copyright (c) 2025 Qualcomm Innovation Center, Inc. All rights reserved.
# SPDX-License-Identifier: Apache-2.0

config BOARD_ENABLE_DCACHE
	bool
	default n

config BOARD_ENABLE_ICACHE
	bool
	default n
```

## boards/qemu/hexagon/Kconfig.defconfig
```kconfig
# Copyright (c) 2025 Qualcomm Innovation Center, Inc. All rights reserved.
# SPDX-License-Identifier: Apache-2.0

if BOARD_QEMU_HEXAGON

config BOARD
	default "qemu_hexagon"

endif # BOARD_QEMU_HEXAGON
```

## boards/qemu/hexagon/Kconfig.qemu_hexagon
```kconfig
# SPDX-License-Identifier: Apache-2.0
# Copyright (c) 2025 Qualcomm Innovation Center, Inc. All rights reserved.

config BOARD_QEMU_HEXAGON
	bool "QEMU Hexagon Virtual Machine"
	depends on SOC_QEMU_HEXAGON_VIRT
	select QEMU_TARGET
	help
	  Enable support for QEMU Hexagon Virtual Machine.
	  This board provides a complete Hexagon VM environment
```

## boards/qemu/hexagon/board.yml
```yaml
board:
  name: qemu_hexagon
  full_name: QEMU Emulation for Hexagon
  vendor: qualcomm
  socs:
    - name: hexagon_v66
```

## boards/qemu/hexagon/qemu_hexagon_defconfig
```kconfig
# SOC configuration is handled by HWMv2 automatically
CONFIG_SOC_HEXAGON_V66=y
CONFIG_SYS_CLOCK_HW_CYCLES_PER_SEC=500000000
CONFIG_LLVM_USE_LLD=y
CONFIG_HEXAGON_FLASH_BASE_ADDRESS=0x80000000
CONFIG_HEXAGON_FLASH_SIZE=16384

# QEMU-specific configuration
CONFIG_QEMU_ICOUNT_SHIFT=6
CONFIG_COMPILER_OPT="-D__IEEE_LITTLE_ENDIAN -D__LITTLE_ENDIAN__"

# Disable LVGL for Hexagon architecture (no display support yet)
CONFIG_LVGL=n
CONFIG_MAIN_STACK_SIZE=2048
CONFIG_IDLE_STACK_SIZE=512
CONFIG_ISR_STACK_SIZE=2048
CONFIG_XIP=n
CONFIG_CONSOLE=y
CONFIG_UART_CONSOLE=y
CONFIG_SERIAL=y
CONFIG_UART_PL011=y
```

## drivers/serial/Kconfig.pl011_hexagon
```kconfig
# SPDX-License-Identifier: Apache-2.0
# Copyright (c) 2025 Qualcomm Innovation Center, Inc. All rights reserved.

config UART_PL011_HEXAGON
	bool "ARM PL011 UART driver for Hexagon"
	depends on HEXAGON
	select SERIAL_HAS_DRIVER
	help
	  Enable the ARM PL011 UART driver for Hexagon platforms.
	  This is used in QEMU's virt machine.

	  Note: This driver is currently in compatibility mode with
	  semihosting console output.
```

## drivers/timer/Kconfig.hexagon
```kconfig
# SPDX-License-Identifier: Apache-2.0
# Copyright (c) 2025 Qualcomm Innovation Center, Inc. All rights reserved.

config HEXAGON_TIMER
	bool "Hexagon VM timer driver"
	depends on HEXAGON
	default y
	select TICKLESS_CAPABLE
	select TIMER_HAS_64BIT_CYCLE_COUNTER
	help
	  This option enables the Hexagon VM timer driver for
	  system clock and timing services.

if HEXAGON_TIMER

config HEXAGON_TIMER_IRQ
	int "Timer interrupt number"
	default 0
	help
	  The interrupt number for the Hexagon system timer.

config HEXAGON_TIMER_PRIORITY
	int "Timer interrupt priority"
	default 0
	help
	  The interrupt priority for the Hexagon system timer.
	  Lower values indicate higher priority.

endif # HEXAGON_TIMER
```

## dts/bindings/interrupt-controller/qcom,hexagon-intc.yaml
```yaml
# Copyright (c) 2025 Qualcomm Innovation Center, Inc. All rights reserved.
# SPDX-License-Identifier: Apache-2.0

description: Qualcomm Hexagon interrupt controller

compatible: "qcom,hexagon-intc"

include: interrupt-controller.yaml

properties:
  reg:
    type: array
    required: true

  "#interrupt-cells":
    const: 2

interrupt-cells:
  - irq
  - flags
```

## soc/hexagon/Kconfig
```kconfig
# Copyright (c) 2025 Qualcomm Innovation Center, Inc. All rights reserved.
# SPDX-License-Identifier: Apache-2.0

config SOC_FAMILY_HEXAGON
	bool

if SOC_FAMILY_HEXAGON

config SOC_FAMILY
	string
	default "hexagon"

#rsource "*/Kconfig.soc"

endif # SOC_FAMILY_HEXAGON
```

## soc/hexagon/Kconfig.bak
```kconfig
# Copyright (c) 2025 Qualcomm Innovation Center, Inc. All rights reserved.
# SPDX-License-Identifier: Apache-2.0

config SOC_FAMILY_HEXAGON
	bool

config SOC_FAMILY
	string
	default "hexagon" if SOC_FAMILY_HEXAGON

source "soc/hexagon/*/Kconfig.soc"
```

## soc/hexagon/Kconfig.defconfig
```kconfig
# Copyright (c) 2025 Qualcomm Innovation Center, Inc. All rights reserved.
# SPDX-License-Identifier: Apache-2.0

if SOC_FAMILY_HEXAGON

config SOC_FAMILY
	default "hexagon"

rsource "*/Kconfig.defconfig"

endif # SOC_FAMILY_HEXAGON
```

## soc/hexagon/Kconfig.defconfig.bak
```kconfig
# Copyright (c) 2025 Qualcomm Innovation Center, Inc. All rights reserved.
# SPDX-License-Identifier: Apache-2.0

if SOC_FAMILY_HEXAGON

config SYS_CLOCK_HW_CYCLES_PER_SEC
	default 500000000

config NUM_IRQS
	default 32

config HEXAGON_VM
	default y

endif # SOC_FAMILY_HEXAGON
```

## soc/hexagon/Kconfig.soc
```kconfig
# Copyright (c) 2025 Qualcomm Innovation Center, Inc. All rights reserved.
# SPDX-License-Identifier: Apache-2.0

rsource "*/Kconfig.soc"
```

## soc/hexagon/Kconfig.soc.bak
```kconfig
# Copyright (c) 2025 Qualcomm Innovation Center, Inc. All rights reserved.
# SPDX-License-Identifier: Apache-2.0

choice
	prompt "Hexagon SoC Selection"
	depends on HEXAGON

config SOC_HEXAGON_V66
	bool "Hexagon V66 Generic SoC"
	select HEXAGON
	select HEXAGON_HAS_V66
	select SOC_FAMILY_HEXAGON

config SOC_HEXAGON_V65
	bool "Hexagon V65 Generic SoC"
	select HEXAGON
	select HEXAGON_HAS_V65
	select SOC_FAMILY_HEXAGON

config SOC_HEXAGON_V60
	bool "Hexagon V60 Generic SoC"
	select HEXAGON
	select HEXAGON_HAS_V60
	select SOC_FAMILY_HEXAGON

endchoice

config SOC_SERIES
	string
	default "hexagon" if SOC_FAMILY_HEXAGON

config SOC
	string
	default "hexagon_v66" if SOC_HEXAGON_V66
	default "hexagon_v65" if SOC_HEXAGON_V65
	default "hexagon_v60" if SOC_HEXAGON_V60
```

## soc/hexagon/common.bak/Kconfig
```kconfig
# Copyright (c) 2025 Qualcomm Innovation Center, Inc. All rights reserved.
# SPDX-License-Identifier: Apache-2.0

config HEXAGON_VM_ENTRY_ADDR
	hex "Entry address for VM guest"
	default 0x80000000
	help
	  Address where the Hexagon VM will load the guest kernel

config HEXAGON_SRAM_BASE_ADDRESS
	hex
	default 0x00000000

config HEXAGON_SRAM_SIZE
	int "SRAM size in KB"
	default 1024

config HEXAGON_FLASH_BASE_ADDRESS
	hex
	default 0x80000000

config HEXAGON_FLASH_SIZE
	int "Flash size in KB"
	default 16384
```

## soc/hexagon/hexagon-qemu/Kconfig
```kconfig
# Copyright (c) 2016 Linaro Limited
# SPDX-License-Identifier: Apache-2.0

config SOC_FAMILY_HEXAGON_QEMU
	bool

config SOC_FAMILY
	string
	default "hexagon-qemu"
	depends on SOC_FAMILY_HEXAGON_QEMU

source "soc/hexagon/hexagon-qemu/*/Kconfig.soc"
```

## soc/hexagon/hexagon-qemu/Kconfig.defconfig
```kconfig
# Hexagon SoC configuration options

# SPDX-License-Identifier: Apache-2.0

if SOC_HEXAGON

config SOC
	default "hexagon"


endif
```
