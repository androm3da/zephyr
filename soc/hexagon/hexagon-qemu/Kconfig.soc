## soc/hexagon/hexagon-qemu/Kconfig.soc
```kconfig
# SPDX-License-Identifier: Apache-2.0

source "soc/hexagon/hexagon-qemu/*/Kconfig.series"
```

## soc/hexagon/hexagon-qemu/virt/Kconfig.defconfig.series
```kconfig
# Copyright (c) 2020 Cobham Gaisler AB
# SPDX-License-Identifier: Apache-2.0

if SOC_SERIES_HEXAGON_VIRT

config SOC_SERIES
	default "virt"

config SYS_CLOCK_HW_CYCLES_PER_SEC
	default 10000000

config HEXAGON_SOC_INTERRUPT_INIT
	default y

config HEXAGON_HAS_CPU_IDLE
	default y

config NUM_IRQS
	default 1024

config PMP_SLOTS
	default 16

endif
```

## soc/hexagon/hexagon-qemu/virt/Kconfig.series
```kconfig
# Copyright (c) 2020 Cobham Gaisler AB
# SPDX-License-Identifier: Apache-2.0

config SOC_SERIES_HEXAGON_VIRT
	bool "Qualcomm Emualtion Platform"
	select HEXAGON
	select SOC_FAMILY_HEXAGON_QEMU
	select ARCH_HAS_STACK_PROTECTION if PMP_STACK_GUARD
	select ARCH_HAS_CUSTOM_SWAP_TO_MAIN
	select ARCH_HAS_SINGLE_THREAD_SUPPORT
	select ARCH_HAS_THREAD_ABORT
	select ARCH_HAS_STACK_PROTECTION
	select ARCH_HAS_USERSPACE
	select ARCH_HAS_NOCACHE_MEMORY_SUPPORT
	select ARCH_HAS_EXTRA_EXCEPTION_INFO
	select ARCH_HAS_TIMING_FUNCTIONS
	select SEMIHOST
	select SEMIHOST_CONSOLE
	imply XIP
	help
	  This option signifies the use of a Virtual Board.
```

## soc/hexagon/hexagon-qemu/virt/Kconfig.soc
```kconfig
# Copyright (c) 2020 Cobham Gaisler AB
# SPDX-License-Identifier: Apache-2.0

choice
	prompt "QEMU Hexagon VirtIO Board"
	depends on SOC_SERIES_HEXAGON_VIRT

config SOC_HEXAGON_VIRT
	bool "QEMU Hexagon VirtIO Board"
	select ATOMIC_OPERATIONS_BUILTIN
	select INCLUDE_RESET_VECTOR

endchoice
```

## soc/hexagon/hexagon_v66/Kconfig.defconfig
```kconfig
# Copyright (c) 2025 Qualcomm Innovation Center, Inc. All rights reserved.
# SPDX-License-Identifier: Apache-2.0

if SOC_HEXAGON_V66

config SOC
	default "hexagon_v66"

config SOC_SERIES
	default "hexagon_v66"

config SOC_FAMILY
	default "hexagon"

config SOC_PART_NUMBER
	default "HEXAGON_V66"

config SYS_CLOCK_HW_CYCLES_PER_SEC
	default 500000000

config NUM_IRQS
	default 32

config HEXAGON_VM
	bool
	default y

config HEXAGON_HAS_V66
	bool
	default y

config HEXAGON_HAS_V65
	bool
	default y

config HEXAGON_HAS_V60
	bool
	default y

endif # SOC_HEXAGON_V66
```

## soc/hexagon/hexagon_v66/Kconfig.soc
```kconfig
# Copyright (c) 2025 Qualcomm Innovation Center, Inc. All rights reserved.
# SPDX-License-Identifier: Apache-2.0

config SOC_SERIES_HEXAGON_V66
	bool "Hexagon V66 SoC series"

config SOC_SERIES
	string
	default "hexagon_v66" if SOC_SERIES_HEXAGON_V66

config SOC_HEXAGON_V66
	bool "Hexagon V66 SoC"
	select SOC_SERIES_HEXAGON_V66
	select HEXAGON

config SOC
	default "hexagon_v66" if SOC_HEXAGON_V66

config SOC_PART_NUMBER
	default "HEXAGON_V66" if SOC_HEXAGON_V66

config HEXAGON_FLASH_BASE_ADDRESS
	hex "Hexagon flash base address"
	default 0x80000000
	help
	  Base address of flash memory for Hexagon architecture.

config HEXAGON_FLASH_SIZE
	int "Hexagon flash size in KB"
	default 16384
	help
	  Size of flash memory in KB for Hexagon architecture.
```

## soc/qemu/hexagon/Kconfig
```kconfig
# SPDX-License-Identifier: Apache-2.0
# Copyright (c) 2025 Qualcomm Innovation Center, Inc. All rights reserved.

config SOC_QEMU_HEXAGON_VIRT
	bool "QEMU Hexagon Virtual Machine"
	select HEXAGON
	select GEN_ISR_TABLES

config NUM_IRQS
	default 32 if SOC_QEMU_HEXAGON_VIRT

config SOC
	default "qemu_hexagon_virt" if SOC_QEMU_HEXAGON_VIRT

config SOC_SERIES
	default "" if SOC_QEMU_HEXAGON_VIRT

config SOC_FAMILY
	default "" if SOC_QEMU_HEXAGON_VIRT
```
